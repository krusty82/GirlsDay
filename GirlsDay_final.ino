// Text vom Handy ans Display senden

// WLAN Einstellungen

const char *ssid = "Girlsday";
const char *password = "12345678";


#include <ESP8266WiFi.h>
#include <ESPAsyncWebServer.h>
#include <Wire.h>
#include <Adafruit_GFX.h>
#include <Adafruit_SSD1306.h>
#include <OneWire.h>
#include <DallasTemperature.h>

// OLED-Display Parameter
#define SCREEN_WIDTH 128
#define SCREEN_HEIGHT 64
#define OLED_RESET -1
Adafruit_SSD1306 display(SCREEN_WIDTH, SCREEN_HEIGHT, &Wire, OLED_RESET);

// I2C-Pin Definitionen
#define OLED_SCL 12
#define OLED_SDA 14

const unsigned char Girlsday [] PROGMEM = {
	// 'Girlsday2, 128x64px
	0x00, 0x00, 0x00, 0x00, 0x00, 0x00, 0x00, 0x00, 0x00, 0x00, 0x00, 0x00, 0x00, 0x00, 0x00, 0x00, 
	0x00, 0x00, 0x00, 0x00, 0x00, 0x00, 0x00, 0x00, 0x00, 0x00, 0x00, 0x00, 0x00, 0x00, 0x00, 0x00, 
	0x00, 0x00, 0x00, 0x00, 0x00, 0x00, 0x00, 0x00, 0x00, 0x00, 0x00, 0x00, 0x00, 0x00, 0x00, 0x00, 
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	0xff, 0xff, 0xff, 0xff, 0xff, 0xff, 0xff, 0xff, 0xff, 0xff, 0xff, 0xff, 0xff, 0xff, 0xff, 0xff
};

// DS18B20 Temperatur-Sensor
#define ONE_WIRE_BUS 4 // GPIO4 = D2
OneWire oneWire(ONE_WIRE_BUS);
DallasTemperature sensors(&oneWire);
float currentTemperature = 0.0;


AsyncWebServer server(80);

String replaceGermanUmlauts(String text) {
  text.replace("ä", "ae");
  text.replace("ö", "oe");
  text.replace("ü", "ue");
  text.replace("Ä", "Ae");
  text.replace("Ö", "Oe");
  text.replace("Ü", "Ue");
  text.replace("ß", "ss");
  text.replace("ẞ", "ss");
  return text;
}

const char index_html[] PROGMEM = R"rawliteral(
<!DOCTYPE HTML>
<html>
<head>
  <title>Text an OLED senden</title>
  <meta name="viewport" content="width=device-width, initial-scale=1.0">
  <style>
    body {
      font-family: Arial, sans-serif;
      margin: 0;
      padding: 0;
      display: flex;
      align-items: center;
      justify-content: center;
      height: 100vh;
      background-color: #f4f4f9;
    }
    .container {
      background-color: white;
      padding: 20px;
      box-shadow: 0 4px 8px rgba(0,0,0,0.1);
      border-radius: 10px;
      text-align: center;
      max-width: 400px;
      width: 80%;
    }
    .container h1 {
      font-size: 1.5em;
      margin-bottom: 10px;
      color: #333;
    }
    .container p {
      margin: 10px 0;
      font-size: 1.1em;
      color: #444;
    }
    .container textarea {
      width: 90%;
      height: 125px;
      padding: 10px;
      font-size: 1.5em;
      border-radius: 5px;
      border: 1px solid #ddd;
      resize: vertical;
    }
    .container button {
      margin-top: 20px;
      padding: 10px 20px;
      font-size: 1em;
      color: white;
      background-color: #5cb85c;
      border: none;
      border-radius: 5px;
      cursor: pointer;
      transition: background-color 0.3s;
    }
    .container button:hover {
      background-color: #4cae4c;
    }
  </style>
  <script>
    function fetchTemperature() {
      fetch('/temperature')
        .then(response => response.text())
        .then(temp => {
          document.getElementById('tempDisplay').innerText = temp;
        })
        .catch(error => {
          document.getElementById('tempDisplay').innerText = 'Fehler';
          console.error('Temperatur-Fehler:', error);
        });
    }

    window.onload = function() {
      //fetchTemperature(); // beim Laden

      setInterval(fetchTemperature, 5000); // alle 5 Sekunden

      document.getElementById('sendBtn').onclick = function() {
        const text = document.getElementById('textInput').value;
        fetch('/upload', {
          method: 'POST',
          headers: {'Content-Type': 'application/x-www-form-urlencoded'},
          body: 'text=' + encodeURIComponent(text)
        })
        .then(response => {
          if (!response.ok) throw new Error('Netzwerk-Antwort war nicht okay');
          return response.text();
        })
        .then(data => alert(data))
        .catch(error => alert('Fetch-Fehler: ' + error.message));
      };

      document.getElementById('clearBtn').onclick = function () {
        document.getElementById('textInput').value = "";
      };
    };
  </script>
</head>
<body>
  <div class="container">
    <h1>Text an das OLED-Display senden:</h1>
    <p><strong>Aktuelle Temperatur:</strong> <span id="tempDisplay">lade...</span> &deg;C</p>
    <textarea id="textInput" placeholder="Gib hier deinen Text ein"></textarea>
    <button id="sendBtn">An OLED senden</button>
    <button id="clearBtn" class="clear-btn">Text l&ouml;schen</button>
  </div>
</body>
</html>
)rawliteral";

void setup() {
  Serial.begin(115200);
  Wire.begin(OLED_SDA, OLED_SCL);

  display.begin(SSD1306_SWITCHCAPVCC, 0x3C);

  display.clearDisplay();
  display.drawBitmap(0, 0, Girlsday, 128, 128, WHITE);
  display.display();
  display.setTextSize(1);
  display.setTextColor(SSD1306_WHITE);
  display.setCursor(0, 0);

  sensors.begin();
  Serial.println("DS18B20 Sensor gestartet.");

  WiFi.softAP(ssid, password);
  IPAddress myIP = WiFi.softAPIP();
  Serial.print("Access Point IP: ");
  Serial.println(myIP);

  //display.clearDisplay();
  display.setCursor(0, 0);
  display.print("WLAN: ");
  display.println(ssid);
  display.print("IP: ");
  display.println(myIP);
  display.display();

  server.on("/", HTTP_GET, [](AsyncWebServerRequest *request) {
    request->send_P(200, "text/html", index_html);
  });

  server.on("/upload", HTTP_POST, [](AsyncWebServerRequest *request) {
    if (request->hasParam("text", true)) {
      String text = replaceGermanUmlauts(request->getParam("text", true)->value());
      Serial.print("Empfangener Text: ");
      Serial.println(text);

      display.fillRect(0, 16, SCREEN_WIDTH, SCREEN_HEIGHT - 16, SSD1306_BLACK);
      int16_t x = 0, y = 16;
      display.setTextSize(1);

      for (size_t i = 0; i < text.length(); i++) {
        if (x > SCREEN_WIDTH - 6 || text[i] == '\n') {
          x = 0;
          y += 8;
        }
        if (y > SCREEN_HEIGHT - 8) break;
        display.setCursor(x, y);
        if (text[i] != '\n') {
          display.write(text[i]);
          x += 6;
        }
      }
      // display.display();
      request->send(200, "text/plain", "Text empfangen und angezeigt");
    } else {
      request->send(400, "text/plain", "Kein Text empfangen");
    }
  });

  server.on("/temperature", HTTP_GET, [](AsyncWebServerRequest *request) {
    request->send(200, "text/plain", String(currentTemperature, 1));
  });

  server.begin();
  Serial.println("Webserver gestartet.");
}

void loop() {
  static unsigned long lastTempRead = 0;
  static int lastClientCount = -1;
  int currentClientCount = WiFi.softAPgetStationNum();
  sensors.requestTemperatures();
  currentTemperature = sensors.getTempCByIndex(0);

  if (currentClientCount != lastClientCount) {
    display.fillRect(0, 0, SCREEN_WIDTH, 16, SSD1306_BLACK);
    display.setCursor(0, 0);
    display.print("WLAN: ");
    display.println(ssid);

    if (currentClientCount > 0) {
      display.print("C ");
      display.print("IP: ");
      display.println(WiFi.softAPIP());
    } else {
      display.print("IP: ");
      display.println(WiFi.softAPIP());
    }
    display.display();
    lastClientCount = currentClientCount;
  }

  if (millis() - lastTempRead > 5000) {
    sensors.requestTemperatures();
    currentTemperature = sensors.getTempCByIndex(0);
    Serial.print("Temp: ");
    Serial.println(currentTemperature);

    display.fillRect(92, 0, SCREEN_WIDTH-80, 8, SSD1306_BLACK);
    display.setCursor(92, 0);
    display.print("T:");
    display.println(currentTemperature, 1);
    display.display();

    lastTempRead = millis();
  }

  delay(1000);
  display.display();
  yield();
}

